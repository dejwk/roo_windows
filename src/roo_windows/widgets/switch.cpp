#include "switch.h"

#include "roo_display/image/image.h"
#include "roo_display/internal/raw_streamable_overlay.h"
#include "roo_display/ui/tile.h"
#include "roo_time.h"
#include "roo_windows/material3/theme.h"
#include "roo_windows/widgets/resources/circle.h"
#include "roo_windows/widgets/resources/circular_shadow.h"

using namespace roo_display;

namespace roo_windows {

namespace {

// Used at different zoom levels.
[[maybe_unused]] const ::roo_display::Pictogram& slider_18();
[[maybe_unused]] const ::roo_display::Pictogram& slider_24();
[[maybe_unused]] const ::roo_display::Pictogram& slider_36();
[[maybe_unused]] const ::roo_display::Pictogram& slider_48();

static constexpr int kSwitchAnimationMs = 120;
}  // namespace

void Switch::onClicked() {
  OnOffState target = isOn() ? OnOffState::kOff : OnOffState::kOn;
  state_ = (state_ & kFractionMask) | StateBits(target);
  startThumbTransition();
  Widget::onClicked();
}

void Switch::setOnOffState(OnOffState state) {
  if (onOffState() == state) return;
  context().animations().cancel(*this, kThumb);
  state_ = StateBits(state) | EndpointFraction(state);
  setDirty();
}

void Switch::setAppliedThumbFraction(int16_t fraction) {
  if (fraction < 0) fraction = 0;
  if (fraction > 256) fraction = 256;
  state_ = (state_ & kOnOffStateMask) | static_cast<uint16_t>(fraction);
}

void Switch::startThumbTransition() {
  const int16_t target = isOn() ? 256 : 0;
  const int16_t current = appliedThumbFraction();
  context().animations().cancel(*this, kThumb);
  if (current == target ||
      presentationState() != PresentationState::kPresented) {
    snapThumbToLogicalState();
    return;
  }
  AnimationSpec spec = AnimationSpec::value(
      static_cast<float>(current), static_cast<float>(target),
      roo_time::Millis(kSwitchAnimationMs));
  if (context().animations().start(*this, kThumb, spec) !=
      AnimationStatus::kOk) {
    snapThumbToLogicalState();
  }
}

void Switch::snapThumbToLogicalState() {
  context().animations().cancel(*this, kThumb);
  setAppliedThumbFraction(isOn() ? 256 : 0);
  setDirty();
}

int16_t Switch::currentThumbOffsetX() const {
  return (Scaled(19) * appliedThumbFraction() + 128) / 256;
}

roo_display::FpPoint Switch::getPointOverlayFocus() const {
  int16_t content_left = (width() - Scaled(42)) / 2;
  int16_t content_top = (height() - Scaled(24)) / 2;
  return roo_display::FpPoint{
      content_left + 0.5f * (float)(Scaled(24) - 1) + currentThumbOffsetX(),
      content_top + 0.5f * (float)(Scaled(24) - 1)};
}

void Switch::onAnimationFrame(AnimationTag tag, const AnimationSample& sample) {
  if (tag != kThumb) {
    BasicWidget::onAnimationFrame(tag, sample);
    return;
  }
  int16_t fraction = static_cast<int16_t>(sample.value + 0.5f);
  if (fraction == appliedThumbFraction()) return;
  setAppliedThumbFraction(fraction);
  setDirty();
}

void Switch::onPresentationChanged(const PresentationChange& change) {
  if (change.state == PresentationState::kPresented &&
      !change.detached_since_delivery) {
    return;
  }
  snapThumbToLogicalState();
}

void Switch::paint(PaintContext& ctx) const {
  const Theme& th = theme();
  ::roo_windows::material3::ColorToken bg_role = effectiveContainerRole();
  Color circleColor = isOn()
                          ? th.material3Theme().color.accentColorFor(bg_role)
                          : th.material3Theme().color.resolve(
                                ::roo_windows::material3::ColorToken::kSurface);
  Color sliderColor = isOn()
                          ? th.material3Theme().color.accentColorFor(bg_role)
                          : th.material3Theme().color.contentColorFor(bg_role);
  int16_t xoffset = currentThumbOffsetX();
#if ROO_WINDOWS_ZOOM >= 200
  auto slider = slider_48();
  auto circle = circle_48();
  auto shadow = circular_shadow_48();
#elif ROO_WINDOWS_ZOOM >= 150
  auto slider = slider_36();
  auto circle = circle_36();
  auto shadow = circular_shadow_36();
#elif ROO_WINDOWS_ZOOM >= 100
  auto slider = slider_24();
  auto circle = circle_24();
  auto shadow = circular_shadow_24();
#else
  auto slider = slider_18();
  auto circle = circle_18();
  auto shadow = circular_shadow_18();
#endif
  slider.color_mode().setColor(sliderColor);
  circle.color_mode().setColor(circleColor);
  // leaving shadow as black.
  Box outer(0, 0, Scaled(42) - 1, Scaled(24) - 1);
  auto composite = MakeDrawableRawStreamable(
      Overlay(outer, slider, kCenter | kMiddle,
              Overlay(shadow.anchorExtents(), shadow, kCenter | kMiddle, circle,
                      kCenter | kMiddle),
              kLeft.shiftBy(xoffset) | kMiddle));

  roo_display::Tile toggle(&composite, outer, kMiddle);
  ctx.drawTiled(toggle, bounds(), kCenter | kMiddle, isInvalidated());
}

Dimensions Switch::getSuggestedMinimumDimensions() const {
  return Dimensions(Scaled(42), Scaled(24));
}

namespace {

const ::roo_display::Pictogram& slider_18() {
  // Image file slider_18 26x11, 4-bit Alpha,  RLE, 65 bytes.
  static const uint8_t slider_18_data[] PROGMEM = {
      0x30, 0x18, 0x09, 0x63, 0x01, 0x50, 0x38, 0x0A, 0x05, 0x03, 0x30,
      0x38, 0x0A, 0x25, 0x81, 0x30, 0x18, 0x0A, 0x45, 0x01, 0x03, 0x80,
      0x93, 0x50, 0x68, 0x04, 0x50, 0x03, 0x80, 0x93, 0x50, 0x68, 0x04,
      0x50, 0x03, 0x80, 0x93, 0x50, 0x68, 0x04, 0x50, 0x30, 0x18, 0x09,
      0x35, 0x06, 0x80, 0x45, 0x81, 0x10, 0x38, 0x0A, 0x25, 0x03, 0x30,
      0x38, 0x0A, 0x05, 0x03, 0x50, 0x18, 0x09, 0x63, 0x01, 0x30,
  };

  static ::roo_display::Pictogram value(Box(0, 0, 25, 10), Box(0, 0, 25, 10),
                                        slider_18_data, Alpha4(color::Black));
  return value;
}

const ::roo_display::Pictogram& slider_24() {
  // Image file slider_24 34x14, 4-bit Alpha,  RLE, 81 bytes.
  static const uint8_t slider_24_data[] PROGMEM = {
      0x40, 0x30, 0x48, 0x0A, 0x25, 0x04, 0x03, 0x60, 0x28, 0x0B, 0x05, 0x02,
      0x30, 0x28, 0x0B, 0x25, 0x02, 0x28, 0x0B, 0x45, 0x10, 0x38, 0x0B, 0x45,
      0x03, 0x04, 0x80, 0xA0, 0x50, 0x68, 0x07, 0x50, 0x48, 0x0A, 0x15, 0x06,
      0x80, 0xB5, 0x50, 0x68, 0x09, 0x05, 0x04, 0x80, 0xA0, 0x50, 0x68, 0x07,
      0x50, 0x40, 0x38, 0x0A, 0x05, 0x06, 0x80, 0x75, 0x03, 0x18, 0x0A, 0x05,
      0x06, 0x80, 0x75, 0x20, 0x28, 0x0B, 0x25, 0x02, 0x30, 0x28, 0x0B, 0x05,
      0x02, 0x60, 0x30, 0x48, 0x0A, 0x25, 0x04, 0x03, 0x40,
  };

  static ::roo_display::Pictogram value(Box(0, 0, 33, 13), Box(0, 0, 33, 13),
                                        slider_24_data, Alpha4(color::Black));
  return value;
}

const ::roo_display::Pictogram& slider_36() {
  // Image file slider_36 52x22, 4-bit Alpha,  RLE, 149 bytes.
  static const uint8_t slider_36_data[] PROGMEM = {
      0x71, 0x01, 0x02, 0x80, 0xB4, 0x30, 0x20, 0x17, 0x70, 0x38, 0x0C, 0x25,
      0x03, 0x73, 0x02, 0x80, 0xC6, 0x50, 0x27, 0x02, 0x80, 0xD0, 0x50, 0x25,
      0x02, 0x80, 0xD2, 0x50, 0x24, 0x80, 0xD4, 0x53, 0x03, 0x80, 0xD4, 0x50,
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      0xB4, 0x30, 0x20, 0x17, 0x10,
  };

  static ::roo_display::Pictogram value(Box(0, 0, 51, 21), Box(0, 0, 51, 21),
                                        slider_36_data, Alpha4(color::Black));
  return value;
}

const ::roo_display::Pictogram& slider_48() {
  // Image file slider_48 68x28, 4-bit Alpha,  RLE, 196 bytes.
  static const uint8_t slider_48_data[] PROGMEM = {
      0x72, 0x81, 0x13, 0x48, 0x0D, 0x05, 0x81, 0x43, 0x17, 0x72, 0x02, 0x04,
      0x80, 0xD6, 0x50, 0x40, 0x27, 0x50, 0x10, 0x48, 0x0E, 0x25, 0x04, 0x01,
      0x72, 0x01, 0x80, 0xE6, 0x50, 0x17, 0x01, 0x80, 0xF0, 0x50, 0x15, 0x01,
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      0x81, 0x43, 0x17, 0x20,
  };

  static ::roo_display::Pictogram value(Box(0, 0, 67, 27), Box(0, 0, 67, 27),
                                        slider_48_data, Alpha4(color::Black));
  return value;
}

}  // namespace

}  // namespace roo_windows
