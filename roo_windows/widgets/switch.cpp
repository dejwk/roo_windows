#include "switch.h"

#include <Arduino.h>

#include "roo_display/image/image.h"
#include "roo_display/internal/raw_streamable_overlay.h"
#include "roo_display/ui/tile.h"

using namespace roo_display;

namespace roo_windows {

namespace {

const ::roo_display::RleImage4bppxBiased<::roo_display::Alpha4,
                                         ::roo_display::ProgMemPtr>&
circle_18();

const ::roo_display::RleImage4bppxBiased<::roo_display::Alpha4,
                                         ::roo_display::ProgMemPtr>&
circle_24();

const ::roo_display::RleImage4bppxBiased<::roo_display::Alpha4,
                                         ::roo_display::ProgMemPtr>&
circle_36();

const ::roo_display::RleImage4bppxBiased<::roo_display::Alpha4,
                                         ::roo_display::ProgMemPtr>&
circle_48();

const ::roo_display::RleImage4bppxBiased<::roo_display::Alpha4,
                                         ::roo_display::ProgMemPtr>&
shadow_18();

const ::roo_display::RleImage4bppxBiased<::roo_display::Alpha4,
                                         ::roo_display::ProgMemPtr>&
shadow_24();

const ::roo_display::RleImage4bppxBiased<::roo_display::Alpha4,
                                         ::roo_display::ProgMemPtr>&
shadow_36();

const ::roo_display::RleImage4bppxBiased<::roo_display::Alpha4,
                                         ::roo_display::ProgMemPtr>&
shadow_48();

const ::roo_display::RleImage4bppxBiased<::roo_display::Alpha4,
                                         ::roo_display::ProgMemPtr>&
slider_18();

const ::roo_display::RleImage4bppxBiased<::roo_display::Alpha4,
                                         ::roo_display::ProgMemPtr>&
slider_24();

const ::roo_display::RleImage4bppxBiased<::roo_display::Alpha4,
                                         ::roo_display::ProgMemPtr>&
slider_36();

const ::roo_display::RleImage4bppxBiased<::roo_display::Alpha4,
                                         ::roo_display::ProgMemPtr>&
slider_48();

static constexpr int kSwitchAnimationMs = 120;
}  // namespace

bool Switch::onSingleTapUp(XDim x, YDim y) {
  toggle();
  anim_ = millis() & 0x7FFF;
  return Widget::onSingleTapUp(x, y);
}

int16_t Switch::time_animating_ms() const {
  return (millis() & 0x7FFF) - (anim_ & 0x7FFF);
}

void Switch::paintWidgetContents(const Canvas& canvas, Clipper& clipper) {
  if (isAnimating()) {
    int16_t ms = time_animating_ms();
    if (ms < 0 || ms > kSwitchAnimationMs) {
      // Done animating.
      anim_ = 0x8000;
    }
  }
  Widget::paintWidgetContents(canvas, clipper);
  if (isAnimating()) {
    markDirty();
  }
}

void Switch::paint(const Canvas& canvas) const {
  const Theme& th = theme();
  Color circleColor =
      isOn() ? th.color.highlighterColor(canvas.bgcolor()) : th.color.surface;
  Color sliderColor = isOn() ? th.color.highlighterColor(canvas.bgcolor())
                             : th.color.defaultColor(canvas.bgcolor());
  int16_t xoffset;
  if (isAnimating()) {
    int16_t ms = time_animating_ms();
    if (ms < 0 || ms > kSwitchAnimationMs) {
      xoffset = isOn() ? Scaled(19) : 0;
    } else {
      int16_t progress = Scaled(ms * 19) / kSwitchAnimationMs;
      xoffset = isOn() ? progress : Scaled(19) - progress;
    }
  } else {
    xoffset = isOn() ? Scaled(19) : 0;
  }
#if ROO_WINDOWS_ZOOM >= 200
  auto slider = slider_48();
  auto circle = circle_48();
  auto shadow = shadow_48();
#elif ROO_WINDOWS_ZOOM >= 150
  auto slider = slider_36();
  auto circle = circle_36();
  auto shadow = shadow_36();
#elif ROO_WINDOWS_ZOOM >= 100
  auto slider = slider_24();
  auto circle = circle_24();
  auto shadow = shadow_24();
#else
  auto slider = slider_18();
  auto circle = circle_18();
  auto shadow = shadow_18();
#endif
  slider.color_mode().setColor(sliderColor);
  circle.color_mode().setColor(circleColor);
  // leaving shadow as black.
  Box outer(0, 0, Scaled(42) - 1, Scaled(24) - 1);
  auto composite = MakeDrawableRawStreamable(
      Overlay(outer, slider, kCenter | kMiddle,
              Overlay(shadow.anchorExtents(), shadow, kCenter | kMiddle, circle,
                      kCenter | kMiddle),
              kLeft.shiftBy(xoffset) | kMiddle));

  roo_display::Tile toggle(&composite, outer, kMiddle);
  canvas.drawTiled(toggle, bounds(), kCenter | kMiddle, isInvalidated());
}

Dimensions Switch::getSuggestedMinimumDimensions() const {
  return Dimensions(Scaled(42), Scaled(24));
}

namespace {

// Image file circle_18 18x18, 4-bit Alpha,  RLE, 63 bytes.
static const uint8_t circle_18_data[] PROGMEM = {
    0x68, 0x23, 0x55, 0x37, 0x30, 0x80, 0xEC, 0x0E, 0x08, 0x60, 0x10,
    0xCF, 0x90, 0xC0, 0x14, 0x0C, 0xFB, 0x0C, 0x30, 0x8F, 0xD0, 0x82,
    0x0E, 0xFD, 0x81, 0xE0, 0x3F, 0xF0, 0x30, 0x5F, 0xF0, 0x05, 0xFF,
    0x05, 0x03, 0xFF, 0x81, 0x30, 0xEF, 0xD0, 0xE2, 0x08, 0xFD, 0x08,
    0x30, 0xCF, 0xB0, 0xC4, 0x01, 0x0C, 0xF9, 0x0C, 0x01, 0x60, 0x80,
    0xEC, 0x0E, 0x08, 0x73, 0x82, 0x35, 0x53, 0x60,
};

const RleImage4bppxBiased<Alpha4, ProgMemPtr>& circle_18() {
  static RleImage4bppxBiased<Alpha4, ProgMemPtr> value(
      Box(1, 1, 16, 16), Box(0, 0, 17, 17), circle_18_data,
      Alpha4(color::Black));
  return value;
}

// Image file circle_24 24x24, 4-bit Alpha,  RLE, 82 bytes.
static const uint8_t circle_24_data[] PROGMEM = {
    0x68, 0x63, 0x8B, 0xDD, 0xB8, 0x37, 0x30, 0x30, 0xCF, 0x90, 0xC0, 0x37,
    0x06, 0xFD, 0x06, 0x50, 0x6F, 0xF0, 0x63, 0x03, 0xFF, 0xA0, 0x32, 0x0C,
    0xFF, 0xA8, 0x1C, 0x03, 0xFF, 0xC0, 0x30, 0x8F, 0xFC, 0x08, 0x0B, 0xFF,
    0xC0, 0xB0, 0xDF, 0xFC, 0x00, 0xDF, 0xFC, 0x0D, 0x0B, 0xFF, 0xC0, 0xB0,
    0x8F, 0xFC, 0x08, 0x03, 0xFF, 0xC8, 0x13, 0x0C, 0xFF, 0xA0, 0xC2, 0x03,
    0xFF, 0xA0, 0x33, 0x06, 0xFF, 0x06, 0x50, 0x6F, 0xD0, 0x67, 0x03, 0x0C,
    0xF9, 0x0C, 0x03, 0x73, 0x86, 0x38, 0xBD, 0xDB, 0x83, 0x60,
};

const RleImage4bppxBiased<Alpha4, ProgMemPtr>& circle_24() {
  static RleImage4bppxBiased<Alpha4, ProgMemPtr> value(
      Box(2, 2, 21, 21), Box(0, 0, 23, 23), circle_24_data,
      Alpha4(color::Black));
  return value;
}

// Image file circle_36 36x36, 4-bit Alpha,  RLE, 152 bytes.
static const uint8_t circle_36_data[] PROGMEM = {
    0x73, 0x89, 0x01, 0x69, 0xBC, 0xCB, 0x96, 0x17, 0x74, 0x04, 0x0B, 0xFB,
    0x0B, 0x04, 0x77, 0x02, 0x0B, 0xFF, 0x0B, 0x02, 0x74, 0x05, 0x0E, 0xFF,
    0xA0, 0xE0, 0x57, 0x20, 0x7F, 0xFE, 0x07, 0x70, 0x5F, 0xFF, 0x90, 0x55,
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    0x89, 0x01, 0x69, 0xBC, 0xCB, 0x96, 0x17, 0x30,
};

const RleImage4bppxBiased<Alpha4, ProgMemPtr>& circle_36() {
  static RleImage4bppxBiased<Alpha4, ProgMemPtr> value(
      Box(3, 3, 32, 32), Box(0, 0, 35, 35), circle_36_data,
      Alpha4(color::Black));
  return value;
}

// Image file circle_48 48x48, 4-bit Alpha,  RLE, 227 bytes.
static const uint8_t circle_48_data[] PROGMEM = {
    0x77, 0x18, 0x90, 0x36, 0x8A, 0xBB, 0xA8, 0x63, 0x77, 0x76, 0x81, 0x3A,
    0xEF, 0xB8, 0x1E, 0xA3, 0x77, 0x71, 0x04, 0x0C, 0xFF, 0xA0, 0xC0, 0x47,
    0x74, 0x02, 0x0B, 0xFF, 0xE0, 0xB0, 0x27, 0x71, 0x04, 0x0E, 0xFF, 0xF9,
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    0x37, 0x77, 0x68, 0x90, 0x36, 0x8A, 0xBB, 0xA8, 0x63, 0x77, 0x10,
};

const RleImage4bppxBiased<Alpha4, ProgMemPtr>& circle_48() {
  static RleImage4bppxBiased<Alpha4, ProgMemPtr> value(
      Box(4, 4, 43, 43), Box(0, 0, 47, 47), circle_48_data,
      Alpha4(color::Black));
  return value;
}

// Image file shadow_18 18x18, 4-bit Alpha,  RLE, 118 bytes.
static const uint8_t shadow_18_data[] PROGMEM = {
    0x68, 0x31, 0x22, 0x21, 0x73, 0x87, 0x24, 0x67, 0x77, 0x53, 0x17, 0x89,
    0x13, 0x69, 0xBC, 0xCB, 0xA8, 0x52, 0x58, 0x93, 0x37, 0xBC, 0xDE, 0xEE,
    0xDC, 0xA6, 0x23, 0x84, 0x26, 0xBD, 0xEE, 0xB8, 0x4E, 0xEC, 0x95, 0x12,
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    0x41, 0x78, 0x61, 0x24, 0x55, 0x54, 0x27, 0x50, 0x01, 0x71,
};

const RleImage4bppxBiased<Alpha4, ProgMemPtr>& shadow_18() {
  static RleImage4bppxBiased<Alpha4, ProgMemPtr> value(
      Box(1, 1, 17, 17), Box(0, 0, 17, 17), shadow_18_data,
      Alpha4(color::Black));
  return value;
}

// Image file shadow_24 24x24, 4-bit Alpha,  RLE, 193 bytes.
static const uint8_t shadow_24_data[] PROGMEM = {
    0x74, 0x01, 0x77, 0x38, 0x71, 0x23, 0x44, 0x33, 0x21, 0x74, 0x89, 0x31,
    0x34, 0x67, 0x88, 0x87, 0x64, 0x21, 0x71, 0x83, 0x24, 0x68, 0xA8, 0x01,
    0xB8, 0x3A, 0x86, 0x31, 0x68, 0x42, 0x47, 0xAB, 0xC8, 0x01, 0xD8, 0x4C,
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    0x16,
};

const RleImage4bppxBiased<Alpha4, ProgMemPtr>& shadow_24() {
  static RleImage4bppxBiased<Alpha4, ProgMemPtr> value(
      Box(1, 1, 22, 22), Box(0, 0, 23, 23), shadow_24_data,
      Alpha4(color::Black));
  return value;
}

// Image file shadow_36 36x36, 4-bit Alpha,  RLE, 399 bytes.
static const uint8_t shadow_36_data[] PROGMEM = {
    0x77, 0x80, 0x11, 0x77, 0x73, 0x82, 0x11, 0x22, 0x80, 0x13, 0x82, 0x22,
    0x11, 0x77, 0x48, 0x97, 0x11, 0x23, 0x45, 0x56, 0x66, 0x55, 0x44, 0x32,
    0x17, 0x71, 0x8A, 0x11, 0x23, 0x56, 0x78, 0x89, 0x99, 0x98, 0x76, 0x54,
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    0x04, 0x17, 0x50,
};

const RleImage4bppxBiased<Alpha4, ProgMemPtr>& shadow_36() {
  static RleImage4bppxBiased<Alpha4, ProgMemPtr> value(
      Box(2, 2, 34, 34), Box(0, 0, 35, 35), shadow_36_data,
      Alpha4(color::Black));
  return value;
}

// Image file shadow_48 48x48, 4-bit Alpha,  RLE, 679 bytes.
static const uint8_t shadow_48_data[] PROGMEM = {
    0x77, 0x48, 0x04, 0x17, 0x77, 0x74, 0x0F, 0x10, 0xF2, 0x80, 0x03, 0x0F,
    0x20, 0xF1, 0x77, 0x75, 0x8A, 0x21, 0x12, 0x33, 0x44, 0x45, 0x55, 0x54,
    0x44, 0x33, 0x21, 0x17, 0x77, 0x18, 0x71, 0x12, 0x34, 0x55, 0x66, 0x80,
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    0xF1, 0x77, 0x77, 0x68, 0x02, 0x17, 0x75,
};

const RleImage4bppxBiased<Alpha4, ProgMemPtr>& shadow_48() {
  static RleImage4bppxBiased<Alpha4, ProgMemPtr> value(
      Box(3, 3, 46, 46), Box(0, 0, 47, 47), shadow_48_data,
      Alpha4(color::Black));
  return value;
}

// Image file slider_18 26x11, 4-bit Alpha,  RLE, 65 bytes.
static const uint8_t slider_18_data[] PROGMEM = {
    0x30, 0x18, 0x09, 0x63, 0x01, 0x50, 0x38, 0x0A, 0x05, 0x03, 0x30,
    0x38, 0x0A, 0x25, 0x81, 0x30, 0x18, 0x0A, 0x45, 0x01, 0x03, 0x80,
    0x93, 0x50, 0x68, 0x04, 0x50, 0x03, 0x80, 0x93, 0x50, 0x68, 0x04,
    0x50, 0x03, 0x80, 0x93, 0x50, 0x68, 0x04, 0x50, 0x30, 0x18, 0x09,
    0x35, 0x06, 0x80, 0x45, 0x81, 0x10, 0x38, 0x0A, 0x25, 0x03, 0x30,
    0x38, 0x0A, 0x05, 0x03, 0x50, 0x18, 0x09, 0x63, 0x01, 0x30,
};

const RleImage4bppxBiased<Alpha4, ProgMemPtr>& slider_18() {
  static RleImage4bppxBiased<Alpha4, ProgMemPtr> value(
      Box(0, 0, 25, 10), Box(0, 0, 25, 10), slider_18_data,
      Alpha4(color::Black));
  return value;
}

// Image file slider_24 34x14, 4-bit Alpha,  RLE, 81 bytes.
static const uint8_t slider_24_data[] PROGMEM = {
    0x40, 0x30, 0x48, 0x0A, 0x25, 0x04, 0x03, 0x60, 0x28, 0x0B, 0x05, 0x02,
    0x30, 0x28, 0x0B, 0x25, 0x02, 0x28, 0x0B, 0x45, 0x10, 0x38, 0x0B, 0x45,
    0x03, 0x04, 0x80, 0xA0, 0x50, 0x68, 0x07, 0x50, 0x48, 0x0A, 0x15, 0x06,
    0x80, 0xB5, 0x50, 0x68, 0x09, 0x05, 0x04, 0x80, 0xA0, 0x50, 0x68, 0x07,
    0x50, 0x40, 0x38, 0x0A, 0x05, 0x06, 0x80, 0x75, 0x03, 0x18, 0x0A, 0x05,
    0x06, 0x80, 0x75, 0x20, 0x28, 0x0B, 0x25, 0x02, 0x30, 0x28, 0x0B, 0x05,
    0x02, 0x60, 0x30, 0x48, 0x0A, 0x25, 0x04, 0x03, 0x40,
};

const RleImage4bppxBiased<Alpha4, ProgMemPtr>& slider_24() {
  static RleImage4bppxBiased<Alpha4, ProgMemPtr> value(
      Box(0, 0, 33, 13), Box(0, 0, 33, 13), slider_24_data,
      Alpha4(color::Black));
  return value;
}

// Image file slider_36 52x22, 4-bit Alpha,  RLE, 149 bytes.
static const uint8_t slider_36_data[] PROGMEM = {
    0x71, 0x01, 0x02, 0x80, 0xB4, 0x30, 0x20, 0x17, 0x70, 0x38, 0x0C, 0x25,
    0x03, 0x73, 0x02, 0x80, 0xC6, 0x50, 0x27, 0x02, 0x80, 0xD0, 0x50, 0x25,
    0x02, 0x80, 0xD2, 0x50, 0x24, 0x80, 0xD4, 0x53, 0x03, 0x80, 0xD4, 0x50,
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    0xB4, 0x30, 0x20, 0x17, 0x10,
};

const RleImage4bppxBiased<Alpha4, ProgMemPtr>& slider_36() {
  static RleImage4bppxBiased<Alpha4, ProgMemPtr> value(
      Box(0, 0, 51, 21), Box(0, 0, 51, 21), slider_36_data,
      Alpha4(color::Black));
  return value;
}

// Image file slider_48 68x28, 4-bit Alpha,  RLE, 196 bytes.
static const uint8_t slider_48_data[] PROGMEM = {
    0x72, 0x81, 0x13, 0x48, 0x0D, 0x05, 0x81, 0x43, 0x17, 0x72, 0x02, 0x04,
    0x80, 0xD6, 0x50, 0x40, 0x27, 0x50, 0x10, 0x48, 0x0E, 0x25, 0x04, 0x01,
    0x72, 0x01, 0x80, 0xE6, 0x50, 0x17, 0x01, 0x80, 0xF0, 0x50, 0x15, 0x01,
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    0x81, 0x43, 0x17, 0x20,
};

const RleImage4bppxBiased<Alpha4, ProgMemPtr>& slider_48() {
  static RleImage4bppxBiased<Alpha4, ProgMemPtr> value(
      Box(0, 0, 67, 27), Box(0, 0, 67, 27), slider_48_data,
      Alpha4(color::Black));
  return value;
}

}  // namespace

}  // namespace roo_windows